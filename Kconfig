## Kconfig
```kconfig
config HID_ASUS_ALLY
    tristate "Asus Ally gamepad configuration support"
    depends on USB_HID
    depends on LEDS_CLASS
    depends on LEDS_CLASS_MULTICOLOR
    select POWER_SUPPLY
    help
    Support for configuring the Asus ROG Ally gamepad using attributes.
```
